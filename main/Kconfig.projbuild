## main/Kconfig.projbuild
```kconfig
menu "CO4017A0 CANopen mock"

config CANOPEN_NODE_ID
    int "CANopen node ID"
    range 1 127
    default 1

config CANOPEN_BITRATE_KBPS
    int "CAN bitrate (kbit/s)"
    range 10 1000
    default 250

config CANOPEN_HEARTBEAT_MS
    int "Producer heartbeat time (ms)"
    range 0 65535
    default 1000

config CANOPEN_PDO_DEBUG
    bool "Log PDO processing events"
    depends on CO_PDO
    default n
    help
        Log pending RPDOs and scheduled TPDOs from the CANopen task.
        Logging may affect timing and can produce substantial output.

config CANOPEN_RX_LOG
    bool "Log received CAN frames"
    default n
    help
        Queue received CAN frames for logging from the CANopen task.
        Frames can be dropped from the log when the queue is full.

config CANOPEN_TX_GPIO
    int "TWAI TX GPIO"
    range 0 48
    default 15

config CANOPEN_RX_GPIO
    int "TWAI RX GPIO"
    range 0 48
    default 16

endmenu
```
